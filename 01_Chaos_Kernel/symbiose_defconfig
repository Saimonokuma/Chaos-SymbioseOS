## 01_Chaos_Kernel/symbiose_defconfig
```kconfig
# ══════════════════════════════════════════════════════════════════════════
# symbiose_defconfig — SymbioseOS x86_64 Kernel Configuration
#
# KERNEL-002: Minimal x86_64 defconfig for SymbioseOS VMX guest.
# KERNEL-004: Huge pages boot config (CONFIG_CMDLINE)
# KERNEL-005: io_uring support
# KERNEL-006: RDMA/InfiniBand stack
# KERNEL-007: Serial console for debug
# KERNEL-008: CRIU dependencies (namespaces)
# KERNEL-009: YeAH! TCP + CAKE QoS (11 configs)
#
# Usage:
#   cp symbiose_defconfig arch/x86/configs/symbiose_defconfig
#   make ARCH=x86_64 symbiose_defconfig
#   make ARCH=x86_64 -j$(nproc) bzImage
#
# Reference: Interactive_Plan.md §XIV·5, §XI KERNEL-002 through KERNEL-009
# ══════════════════════════════════════════════════════════════════════════

# ── KERNEL-002: Core Architecture (P0) ───────────────────────────────
CONFIG_64BIT=y
CONFIG_X86_64=y
CONFIG_SMP=y
CONFIG_NR_CPUS=256
CONFIG_PREEMPT=y
CONFIG_HIGH_RES_TIMERS=y
CONFIG_NO_HZ_IDLE=y
CONFIG_HZ_1000=y
CONFIG_HZ=1000

# Monolithic kernel — no loadable modules (constitutional constraint)
# CONFIG_MODULES is not set

# ── Essential subsystems ─────────────────────────────────────────────
CONFIG_BLOCK=y
CONFIG_ELF_CORE=y
CONFIG_BINFMT_ELF=y
CONFIG_BINFMT_SCRIPT=y
CONFIG_PROC_FS=y
CONFIG_PROC_SYSCTL=y
CONFIG_SYSFS=y
CONFIG_DEVTMPFS=y
CONFIG_DEVTMPFS_MOUNT=y

# ── Filesystem support ──────────────────────────────────────────────
CONFIG_TMPFS=y
CONFIG_TMPFS_POSIX_ACL=y
CONFIG_EXT4_FS=y
CONFIG_XFS_FS=y

# ── VirtIO (guest must see host hardware via VirtIO) ─────────────────
CONFIG_VIRTIO=y
CONFIG_VIRTIO_PCI=y
CONFIG_VIRTIO_NET=y
CONFIG_VIRTIO_BLK=y
CONFIG_VIRTIO_CONSOLE=y
CONFIG_VIRTIO_BALLOON=y

# ── RAM Disk (initramfs support) ─────────────────────────────────────
CONFIG_BLK_DEV_RAM=y
CONFIG_BLK_DEV_RAM_COUNT=16
CONFIG_BLK_DEV_RAM_SIZE=65536
CONFIG_BLK_DEV_INITRD=y

# ── KERNEL-007: Serial Console for Debug (P0) ────────────────────────
# ChaosLoader intercepts ttyS0 for guest boot messages
CONFIG_SERIAL_8250=y
CONFIG_SERIAL_8250_CONSOLE=y
CONFIG_SERIAL_8250_PCI=y
CONFIG_SERIAL_8250_NR_UARTS=4
CONFIG_SERIAL_8250_RUNTIME_UARTS=4
CONFIG_SERIAL_CORE=y
CONFIG_SERIAL_CORE_CONSOLE=y
CONFIG_TTY=y
CONFIG_VT=y
CONFIG_CONSOLE_TRANSLATIONS=y
CONFIG_VT_CONSOLE=y

# ── Control Groups (required for process isolation) ──────────────────
CONFIG_CGROUPS=y
CONFIG_CGROUP_SCHED=y
CONFIG_CGROUP_CPUACCT=y
CONFIG_CGROUP_DEVICE=y
CONFIG_CGROUP_FREEZER=y
CONFIG_CGROUP_PIDS=y
CONFIG_MEMCG=y

# ── KERNEL-008: CRIU / Checkpoint-Restore Dependencies (P1) ─────────
# Required for CRIU dump/restore (HIVE-MOSIX-001/003)
CONFIG_CHECKPOINT_RESTORE=y
CONFIG_NAMESPACES=y
CONFIG_PID_NS=y
CONFIG_NET_NS=y
CONFIG_UTS_NS=y
CONFIG_IPC_NS=y
CONFIG_USER_NS=y
CONFIG_CGROUP_NS=y

# ── BPF (required for bpf_gpu_monitor.bpf.c) ────────────────────────
CONFIG_BPF=y
CONFIG_BPF_SYSCALL=y
CONFIG_BPF_JIT=y
CONFIG_BPF_JIT_ALWAYS_ON=y
CONFIG_BPF_EVENTS=y
CONFIG_FTRACE=y
CONFIG_KPROBES=y
CONFIG_UPROBES=y
CONFIG_UPROBE_EVENTS=y

# ── KERNEL-005: io_uring Support (P1) ────────────────────────────────
# Required for tensor_io.c SQPOLL async I/O (HIVE-MOSIX-006)
CONFIG_IO_URING=y

# ── Networking (core) ────────────────────────────────────────────────
CONFIG_NET=y
CONFIG_INET=y
CONFIG_IP_MULTICAST=y
CONFIG_TCP_CONG_CUBIC=y
CONFIG_IPV6=y
CONFIG_UNIX=y
CONFIG_PACKET=y
CONFIG_NETFILTER=y
CONFIG_NF_CONNTRACK=y
CONFIG_NETFILTER_XTABLES=y
CONFIG_IP_NF_IPTABLES=y
CONFIG_IP_NF_MANGLE=y
CONFIG_IP_NF_FILTER=y

# ── KERNEL-009: YeAH! TCP + CAKE QoS (P1) — 11 configs ──────────────
# Reference: YeAH-TCP paper, tc-cake(8), Firewalla CAKE PDF
#
# TCP congestion control
CONFIG_TCP_CONG_YEAH=y
CONFIG_DEFAULT_TCP_CONG="yeah"
#
# CAKE qdisc (COBALT AQM + DRR++ + DiffServ4 tins)
CONFIG_NET_SCH_CAKE=y
#
# FQ-CoDel (fallback)
CONFIG_NET_SCH_FQ_CODEL=y
#
# Firewall mark classifier (for DSCP → tin mapping)
CONFIG_NET_CLS_FW=y
#
# Ingress shaping (PDF §6 — IFB + mirred redirect)
CONFIG_NET_CLS_ACT=y
CONFIG_NET_CLS_U32=y
CONFIG_NET_ACT_MIRRED=y
CONFIG_NET_SCH_INGRESS=y
CONFIG_IFB=y
#
# Byte Queue Limits (critical for 10G+ NICs)
CONFIG_BQL=y

# ── KERNEL-006: RDMA / InfiniBand Stack (P1) ─────────────────────────
# Required for libibverbs zero-copy migration (§VIII·3)
CONFIG_INFINIBAND=y
CONFIG_INFINIBAND_USER_MAD=y
CONFIG_INFINIBAND_USER_ACCESS=y
CONFIG_INFINIBAND_ADDR_TRANS=y
CONFIG_MLX5_CORE=y
CONFIG_MLX5_INFINIBAND=y

# ── Memory management (huge pages + NUMA) ────────────────────────────
CONFIG_HUGETLBFS=y
CONFIG_HUGETLB_PAGE=y
CONFIG_TRANSPARENT_HUGEPAGE=y
CONFIG_TRANSPARENT_HUGEPAGE_ALWAYS=y
CONFIG_NUMA=y
CONFIG_NUMA_BALANCING=y
CONFIG_X86_64_ACPI_NUMA=y
CONFIG_MIGRATION=y
CONFIG_COMPACTION=y

# ── KERNEL-004: Huge Pages Boot Config (P1) ──────────────────────────
# Required for tensor_alloc.c huge page cascade (HIVE-MOSIX-007)
# CONFIG_CMDLINE also contains KERNEL-007 serial console
CONFIG_CMDLINE_BOOL=y
CONFIG_CMDLINE="console=ttyS0,115200n8 hugepagesz=1G hugepages=64 hugepagesz=2M hugepages=512"
# CONFIG_CMDLINE_OVERRIDE is not set

# ── PCI / ACPI (for hardware passthrough) ────────────────────────────
CONFIG_PCI=y
CONFIG_PCI_MSI=y
CONFIG_ACPI=y
CONFIG_ACPI_NUMA=y

# ── GPU support (for CUDA/ROCm passthrough) ──────────────────────────
CONFIG_DRM=y
CONFIG_DRM_VIRTIO_GPU=y

# ── NVMe (direct block access to tensor store) ──────────────────────
CONFIG_NVME_CORE=y
CONFIG_BLK_DEV_NVME=y

# ── Security (minimal — LLM is PID 1, no multiuser) ─────────────────
CONFIG_SECCOMP=y
CONFIG_SECCOMP_FILTER=y
CONFIG_SECURITY=y
# CONFIG_SELINUX is not set
# CONFIG_APPARMOR is not set

# ── Debug (minimal, for development) ─────────────────────────────────
CONFIG_PRINTK=y
CONFIG_BUG=y
CONFIG_DEBUG_KERNEL=y
CONFIG_DEBUG_INFO=y
CONFIG_MAGIC_SYSRQ=y
CONFIG_PANIC_ON_OOPS=y
CONFIG_PANIC_TIMEOUT=5

# ── Performance ──────────────────────────────────────────────────────
CONFIG_PERF_EVENTS=y
CONFIG_CC_OPTIMIZE_FOR_PERFORMANCE=y
# CONFIG_CC_OPTIMIZE_FOR_SIZE is not set
```
